## arch/arm/src/goldfish/Kconfig
```kconfig
#
# For a description of the syntax of this configuration file,
# see the file kconfig-language.txt in the NuttX tools repository.
#

if ARCH_CHIP_GOLDFISH_ARM

menu "Goldfish Virt Chip Selection"

choice
	prompt "Goldfish Core Configuration"
	default ARCH_CHIP_GOLDFISH_CORTEXA7

config ARCH_CHIP_GOLDFISH_CORTEXA7
	bool "Goldfish virtual Processor (cortex-a7)"
        select ARCH_CORTEXA7
	select ARCH_HAVE_ADDRENV
	select ARCH_HAVE_LOWVECTORS
	select ARCH_HAVE_MULTICPU
	select ARCH_HAVE_TRUSTZONE
	select ARCH_NEED_ADDRENV_MAPPING
	select ARMV7A_HAVE_GICv2
	select ARMV7A_HAVE_GTM
	select ARMV7A_HAVE_PTM

endchoice # Goldfish Chip Selection

endmenu # "Goldfish Virt Chip Selection"

config GOLDFISH_RTC_PL031_BASE
	hex "GOLDFISH RTC PL031 BASE"
	default 0x09010000
	depends on RTC_PL031

config GOLDFISH_RTC_PL031_IRQ
	hex "GOLDFISH RTC PL031 IRQ"
	default 0x22
	depends on RTC_PL031

endif # ARCH_CHIP_GOLDFISH_ARM
```

## drivers/cpufreq/Kconfig
```kconfig
#
# For a description of the syntax of this configuration file,
# see the file kconfig-language.txt in the NuttX tools repository.
#

config CPUFREQ
	bool "cpufreq"
	default n
	---help---
		CPUFREQ

if CPUFREQ

choice
	prompt "CPUFREQ_DEFAULT_GOVERNOR"
	default CPUFREQ_DEFAULT_GOV_PERFORMANCE

config CPUFREQ_DEFAULT_GOV_PERFORMANCE
	bool "cpufreq_performance"
	---help---
		cpufreq_performance governor

config CPUFREQ_DEFAULT_GOV_POWERSAVE
	bool "cpufreq_powersave"
	---help---
		cpufreq_powersave governor

endchoice

endif
```

## libs/libc/fdt/Kconfig
```kconfig
#
# For a description of the syntax of this configuration file,
# see the file kconfig-language.txt in the NuttX tools repository.
#

config LIBFDT
	bool "Flattened Device Tree Library"
	default n
	---help---
		Enable or disable Flattened Device Tree Library features

if LIBFDT

config DTC_VERSION
	string "DTC Version"
	default "1.7.0"
	---help---
		Version of DTC source code to download from github.

endif # LIBFDT
```

## openamp/Kconfig
```kconfig
#
# For a description of the syntax of this configuration file,
# see the file kconfig-language.txt in the NuttX tools repository.
#

config OPENAMP
	bool "Open Asymmetric Multi Processing support"
	default n
	---help---
		Enable or disable Open Asymmetric Multi Processing features

if OPENAMP

config OPENAMP_CACHE
	bool "Enable OpenAmp cache support"
	default n
	---help---
		Enable or disable OpenAmp cache support (VIRTIO_CACHED_BUFFERS and
		VIRTIO_CACHED_VRINGS)

config OPENAMP_RPMSG_DEBUG
	bool "Enable OpenAmp Rpmsg Debug"
	default n

config OPENAMP_VQUEUE_DEBUG
	bool "Enable OpenAmp Virtio Queue Debug"
	default n

endif # OPENAMP
```
